## drivers/media/platform/msm/Kconfig
```kconfig
config MSM_CAMERA_V4L2
	 bool "MSM Camera V4L2 Interface"
	 depends on MSM_CAMERA
	 default n
	 ---help---
	   This flag enables V4L2 interface of MSM
	   camera driver. If enabled, application interacts
	   with /dev/video0 through V4L2 APIs. Otherwise,
	   native APIs are used through /dev/config0, /dev/frame0,
	   and /dev/control0.

choice
	 prompt "Qualcomm MSM camera and video capture support"
	 depends on MSM_CAMERA
	 default MSM_CAMERA_7X30

	 config MSM_CAMERA_7X30
	    bool "msm camera 7x30"

	 config MSM_CAMERA_8X60
	    bool "msm camera 8x60"

endchoice

config CAMERA_MULTISHOT
	bool "Qualcomm MSM Multishot support"
	depends on MSM_CAMERA && ARCH_MSM7X30
	default n
	---help---
	 Enable support for Multishot

config FLASH_BACKLIGHT_OFF
	bool "Turn off backlight when flash high"
	depends on MSM_CAMERA
	help
	 Turn off backlight when flash high

comment "Camera Sensor Selection"

config S5K3H1GX
	bool "Sensor s5k3h1gx"
	depends on MSM_CAMERA
	default n
	---help---
	  Samsung 8M 3H1 MIPI AF Sensor

config OV8810
	bool "Sensor ov8810"
	depends on MSM_CAMERA
	default n
	---help---
	  OmniVision 8M Bayer Sensor

config MSM_CAMERA_FLASH
	bool "Qualcomm MSM camera flash support"
	depends on MSM_CAMERA
	default n
	---help---
	  Enable support for LED flash for msm camera

config MSM_GEMINI
	tristate "Qualcomm MSM Gemini Jpeg Engine support"
	depends on MSM_CAMERA && (ARCH_MSM7X30 || ARCH_MSM8X60 || ARCH_MSM8960)
	default n
	---help---
	  Enable support for Gemini Jpeg Engine

config MSM_VPE
	tristate "Qualcomm MSM Video Pre-processing Engine support"
	depends on MSM_CAMERA && (ARCH_MSM7X30 || ARCH_MSM8X60)
	default y
	---help---
	  Enable support for Video Pre-processing Engine

config QUP_EXCLUSIVE_TO_CAMERA
	bool "QUP exclusive to camera"
	depends on MSM_CAMERA
	default y
	---help---
	  This flag enabled states that QUP
	  is exclusive to camera. In case this
	  is disabled, the lvs1 voltage is enabled
	  by QUP in the board file as QUP is used by
	  applications other than camera.
```

## drivers/usb/otg/Kconfig
```kconfig
#
# USB OTG infrastructure may be needed for peripheral-only, host-only,
# or OTG-capable configurations when OTG transceivers or controllers
# are used.
#

comment "OTG and related infrastructure"

if USB || USB_GADGET

config USB_MSM_OTG_72K
	bool "OTG support for Legcay Qualcomm on-chip USB controller"
	depends on ARCH_MSM
	default USB_MSM_72K
	help
	  Enable this to support the USB OTG transceiver on MSM chips. It
	  handles PHY initialization, clock management, low power mode and
	  workarounds required after resetting the hardware. This driver is
	  required for even peripheral only or host only mode configuration.
	  Supports SRP and HNP when both gadget and Host are selected.

endif # USB || OTG
```

## drivers/video/Kconfig
```kconfig
#
# Video configuration
#

menu "Graphics support"
	depends on HAS_IOMEM

config HAVE_FB_ATMEL
	bool

config SH_MIPI_DSI
	tristate
	depends on (SUPERH || ARCH_SHMOBILE) && HAVE_CLK

config SH_LCD_MIPI_DSI
	bool

source "drivers/char/agp/Kconfig"

source "drivers/gpu/vga/Kconfig"

menu "Direct Rendering Manager"
source "drivers/gpu/drm/Kconfig"
endmenu

source "drivers/gpu/stub/Kconfig"

source "drivers/gpu/ion/Kconfig"

source "drivers/gpu/msm/Kconfig"

menu "Frame buffer Devices"
source "drivers/video/fbdev/Kconfig"
endmenu

source "drivers/video/backlight/Kconfig"

config VGASTATE
       tristate
       default n

if VT
	source "drivers/video/console/Kconfig"
endif

if FB || SGI_NEWPORT_CONSOLE
	source "drivers/video/logo/Kconfig"

endif


endmenu
```

## drivers/video/fbdev/omap2/Kconfig
```kconfig
config OMAP2_VRAM
	bool

config OMAP2_VRFB
	bool

source "drivers/video/fbdev/omap2/dss/Kconfig"
source "drivers/video/fbdev/omap2/omapfb/Kconfig"
source "drivers/video/fbdev/omap2/displays/Kconfig"
```

## sound/soc/msm/Kconfig
```kconfig
menu "MSM SoC Audio support"

config SND_MSM7KV2_SOC
	tristate "SoC Audio for the MSM7KV2 chip"
	depends on ARCH_MSM7X30 && (MSM7KV2_AUDIO || MSM7KV2_1X_AUDIO)
	default y
	help
	  To add support for ALSA PCM driver for QSD8k board.

config SND_MSM7KV2_DAI_SOC
	tristate "SoC CPU/CODEC DAI for the MSM7x30 chip"
	depends on SND_MSM7KV2_SOC
	default y
	help
	 To add support for ALSA PCM driver for MSM7x30 board.

config SND_MSM_SOC_MSM7KV2
	tristate "SoC Audio support for MSM7KV2"
	depends on SND_MSM7KV2_SOC
	default y
	help
	 To add support for SoC audio on qsd8k.

endmenu
```
